#include <Arduino.h>
#if defined(ESP8266)
#include <ESP8266WiFi.h>
#else
#include <WiFi.h>
#endif

#include <WiFiManager.h>
#include <Separador.h>
#include <PubSubClient.h>
#include <WiFiClientSecure.h>

#include <SPI.h>
#include <Wire.h>             // libreria para bus I2C
#include <Adafruit_GFX.h>     // libreria para pantallas graficas
#include <Adafruit_SSD1306.h> // libreria para controlador SSD1306
#include <Adafruit_SH110X.h>

#define i2c_Address 0x3c // inicializa con I2C en la direccion 0x3C
#define ANCHO 128        // reemplaza ocurrencia de ANCHO por 128
#define ALTO 64          // reemplaza ocurrencia de ALTO por 64

//#define OLED_RESET 4      // necesario por la libreria pero no usado
// Adafruit_SSD1306 oled(ANCHO, ALTO, &Wire, OLED_RESET);  // crea objeto OLED SSD1306
#define OLED_RESET -1                                                     // necesario por la libreria pero no usado
Adafruit_SH1106G oled = Adafruit_SH1106G(ANCHO, ALTO, &Wire, OLED_RESET); // crea objeto OLED SH1106

#define LOGO16_GLCD_HEIGHT 32
#define LOGO16_GLCD_WIDTH 32

const unsigned char PROGMEM logo_hydrocrop[] = {
    0x00, 0x00, 0x00, 0x00, 0x00, 0x00, 0x00, 0x00, 0x00, 0x00, 0x00, 0x00, 0x00, 0x00, 0x00, 0x00,
    0x00, 0x00, 0x00, 0x00, 0x00, 0x00, 0x00, 0x00, 0x00, 0x00, 0x00, 0x00, 0x00, 0x00, 0x00, 0x00,
    0x00, 0x00, 0x00, 0x00, 0x00, 0x00, 0x1F, 0xFF, 0xFE, 0x00, 0x00, 0x00, 0x00, 0x00, 0x00, 0x00,
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    0x00, 0x00, 0x00, 0x00, 0x00, 0x00, 0x00, 0x00, 0x00, 0x00, 0x00, 0x00, 0x00, 0x00, 0x00, 0x00};

//*********************************
//*********** CONFIG **************
//*********************************



// ENTRADAS

#define WIFI_PIN 23

const int sCap1   = 25; //SENSOR DE NIVEL MELASA CAPACITIVO 01
const int sCap2   = 26; //SENSOR DE NIVEL MELASA CAPACITIVO 02
const int sCap3   = 27; //SENSOR DE NIVEL MELASA CAPACITIVO 03
const int sOptico = 34; //SENSOR DE NIVEL ESPUMA OPTICO
const int sTemp   = 35; //SENSOR DE TEMPERATURA MELADA

const int sAmp1 = 32; // Entrada 4-20 mA
const int sAmp2 = 33; // Entrada 4-20 mA

// SALIDAS

#define bomba   13 //BOMBA ANTIDERRAME / relay1
#define relay2   9
#define mosfet1 10
#define mosfet2 12


//INICIALIZACION
int estadoCap1 = 0; //NIVEL ALTO
int estadoCap2 = 0; //NIVEL MEDIO
int estadoCap3 = 0; //NIVEL BAJO

// NIVEL DE AGUA CONFIG
char *estado;

// VARIABLES TIEMPO DE CIRCULACION

int timer;
int ptime = 5; // En minutos.
int contA = 0; // Variables de inicializacion.

//************************************
//***** HOSTING + BROKER MQTT ********
//************************************
// estos datos deben estar configurador también en las constantes de tu panel
//  NO USES ESTOS DATOS PON LOS TUYOS!!!!
const String serial_number = "797171";
const String insert_password = "285289";
const String get_data_password = "420285";
const char *server = "liandev.tk";

// MQTT
const char *mqtt_server = "broker.emqx.io";
const int mqtt_port = 8084;

// no completar, el dispositivo se encargará de averiguar qué usuario y qué contraseña mqtt debe usar.
char mqtt_user[20] = "";
char mqtt_pass[20] = "";

const int expected_topic_length = 26;

WiFiManager wifiManager;
WiFiClientSecure client;
PubSubClient mqttclient(client);
WiFiClientSecure client2;

Separador s;


//************************************
//***** DECLARACION FUNCIONES ********
//************************************

void Cap1();
void Cap2();
void Cap3();

void Optico();
void Temp();

void Amp1(); // entrada 4-20ma
void Amp2(); // entrada 4-20ma

// funciones de salidas
void fbomba();
void Rele2();

void MosFet1();
void MosFet2();

//*************************************
//********      GLOBALS         *******
//*************************************

byte sw1 = 0;      // BOMBA DE AGUA - Variable Global de Inicializacion

float temp;
int nivCap;

void setup()
{
  Serial.begin(115200); // inicializa comunicacion serie a 1155200 bps
  Wire.begin();                  // inicializa bus I2C
  oled.begin(i2c_Address, true); // inicializa pantalla con direccion 0x3C

  // oled.stopscroll();
  oled.clearDisplay();
  oled.drawBitmap(0, 0, logo_hydrocrop, 128, 64, WHITE); //LOGO EN LCD
  oled.display();
  delay(2000);

   myOled(); // PANTALLA MENU PRINCIPAL

  Serial.println("inicio");

  pinMode(sCap1, INPUT);
  pinMode(sCap2, INPUT);
  pinMode(sCap3, INPUT);

  pinMode(bomba, OUTPUT);
  pinMode(relay2, OUTPUT);
  pinMode(mosfet1, OUTPUT);
  pinMode(mosfet2, OUTPUT);

  digitalWrite(bomba, LOW);
  digitalWrite(relay2, LOW);
  digitalWrite(mosfet1, LOW);
  digitalWrite(mosfet2, LOW);
}

void loop()
{
  // Wait a few seconds between measurements.
  delay(2000);

  Serial.println("LECTURAS ENTRADAS ");

  Cap1();
  Cap2();
  Cap3();

  Optico();
  Temp();

  Amp1();
  Amp2();
 
}

// SENSOR OPTICO 1 - NIVEL BAJO
void Cap1()
{  
 
}

void Cap2()
{  
  
}

void Cap3()
{
  
}

void Optico()
{
  Serial.print("Valor Sensor Optico     : ");
  Serial.println(analogRead(sOptico));
  float volts = analogRead(sOptico)*(3/4095);  
  Serial.println(analogRead(volts));
}

void Temp()
{
  Serial.print("Valor Sensor Temperatura: ");
      int sum = 0;
    for(int i=0;i<1000;i++){
      sum = sum + analogRead(sTemp); //Almacenos la lectura analogica 
      //buf[i]=analogRead(ptpin); //Almacenos la lectura analogica
    //  delay(10);
    } 
    int promedio = sum / 1000; 
    
    int y = promedio;
    float x = (1000*( y )/9107.0)+6.5;
    temp = x;

    Serial.print("temperatura= ");
    Serial.println(temp); 
   // delay(10);
}

void Amp1()
{
}

void Amp2()
{
}

// PANTALLA OLED

void myOled()
{
  int temp;
  oled.clearDisplay();
  oled.setTextSize(1);                             // Normal 1:1 pixel scale
  oled.setTextColor(SSD1306_BLACK, SSD1306_WHITE); // Draw white text
  oled.setCursor(15, 5);                           // Columna, Fila
  oled.println(F("MENU PRINCIPAL"));

  oled.setTextColor(SSD1306_WHITE);
  oled.setCursor(1, 20);
  oled.print(F("TEMP LIQ: "));
  oled.print(temp);
  oled.println(F("C"));
  delay(5);

  if (digitalRead(nivCap) == 0)
  {

    oled.setTextColor(SSD1306_WHITE); // Draw white text
    oled.setCursor(1, 50);
    oled.print(F("NIVEL: VACIO    "));

    delay(250);
  }
  
  switch (nivCap)
  {
  case 0:
    /* code */
    oled.setTextColor(SSD1306_WHITE); // Draw white text
    oled.setCursor(1, 50);
    oled.print(F("NIVEL: VACIO    "));

    delay(250);
    break;
  
    case 1:
    /* code */
    oled.setTextColor(SSD1306_WHITE); // Draw white text
    oled.setCursor(1, 50);
    oled.print(F("NIVEL: BAJO    "));

    delay(250);
    break;

    case 2:
    /* code */
    oled.setTextColor(SSD1306_WHITE); // Draw white text
    oled.setCursor(1, 50);
    oled.print(F("NIVEL: MEDIO    "));

    delay(250);
    break;

    case 3:
    /* code */
    oled.setTextColor(SSD1306_WHITE); // Draw white text
    oled.setCursor(1, 50);
    oled.print(F("NIVEL: ALTO    "));

    delay(250);
    break;
  
  }

  /*
  oled.setTextColor(SSD1306_WHITE);
  oled.setCursor(1,50);
  oled.println(F("by ZENTENO-GAMBINO"));
  delay(50);
*/
  oled.display();
}

// OLED CONECTANDO AL FI WI

void oledWiFiConect()
{

  // oled.stopscroll();
  oled.clearDisplay();
  oled.setTextSize(2);              // Normal 1:1 pixel scale
  oled.setTextColor(SSD1306_WHITE); // Draw white text
  oled.setCursor(0, 10);            // Columna, Fila
  oled.println(F("Conectando"));
  oled.setCursor(0, 30);
  oled.println(F("a Wi-Fi..."));
  oled.display();
  delay(5);
}

// OLED WI FI CONEXION EXITOSA

void oledWiFi()
{

  // oled.stopscroll();
  oled.clearDisplay();
  oled.setTextSize(2);              // Normal 1:1 pixel scale
  oled.setTextColor(SSD1306_WHITE); // Draw white text
  oled.setCursor(15, 10);           // Columna, Fila
  oled.println(F("Conexion"));
  oled.setCursor(15, 30);
  oled.println(F("MQTT"));

  oled.setCursor(15, 50);
  oled.println(F("EXITOSA"));

  oled.display();
  delay(500);
  oled.clearDisplay();
}

// FUNCION DE RESET
void ReStartESP()
{

  delay(300);
  ESP.restart(); // PARA ESP32
}

// FUNCION ANTI DERRAME BOMBA H2O

void fbomba()
{

  timer = ptime * 20.95 * 10 * 5;
  contA = contA + 10;

  if (sw1 == 1 || contA >= timer)
  {

    if (digitalRead(nivpin) == 1) // ESTA EN OPTIMO?
    {
      digitalWrite(bomba, HIGH); // ACTIVA BOMBA
      sw1 = 1;
      eHO2 = 1;
      delay(250);
    }
  }
  if (sw1 == 0 || digitalRead(nivpin) == 0)
  {
    digitalWrite(bomba, LOW);
    sw1 = 0;
    eHO2 = 0;
  }

  if (contA >= timer)
  {
   // Serial.print("Contador :");
    //Serial.print(contA);
    contA = 0;
  }
}